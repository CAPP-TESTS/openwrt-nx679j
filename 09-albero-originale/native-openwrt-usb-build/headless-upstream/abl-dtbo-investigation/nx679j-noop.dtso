/dts-v1/;
/plugin/;

/ {
	/* ABL selection metadata copied from the active stock DTBO entry 35. */
	qcom,msm-id = <0x1c9 0x20000>, <0x1e2 0x20000>;
	qcom,board-id = <0x10008 0x0>;
	qcom,pmic-id = <0x2f 0x0 0x0 0x0 0x0 0x0 0x0 0x0 0x41 0x41>;
};
